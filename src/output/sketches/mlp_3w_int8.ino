#include <Arduino.h>
#include <avr/pgmspace.h>
#include <string.h>

#define INPUT_SIZE  1000
#define HIDDEN1     32
#define HIDDEN2     16
#define OUTPUT_SIZE 5
#define N_TEST      10

#define MULT1  ((int32_t)1374348473L)
#define SHIFT1 9
#define MULT2  ((int32_t)1671721308L)
#define SHIFT2 6
#define MULT3  ((int32_t)2146954201L)
#define SHIFT3 7

const int8_t W1_q[] PROGMEM = {
  1, 1, 0, 1, 1, 1, -1, 0, 0, 0, 1, 1, 1, 0, 1, 1,
  0, 0, 1, -1, 0, 0, 0, 1, 0, 0, 0, 1, 1, 0, 1, 1,
  22, -68, -55, 68, 34, 61, -29, -31, -52, -53, 11, -3, 2, 3, -19, -16,
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  1, 11, -1, -4, -4, -2, -2, -10, 0, -2, 2, -6, -2, 7, -5, -4
};

const int32_t b1_q[] PROGMEM = {
  -2799, 790, 214, 2066, -12, 131, -1491, 40, 723, 209, -1684, -1559, -3277, -3862, 2568, -2600,
  44, 1240, -130, 2964, -1656, -1105, -2, 353, 3279, 214, -3880, 858, -1998, 231, 578, 257
};

const int8_t W2_q[] PROGMEM = {
  -9, -36, -7, -1, -19, 11, -4, -41, -49, 16, 3, 7, -31, -2, -4, 46,
  -1, -3, -2, -2, -15, 1, -1, -11, -2, 2, 1, -2, 0, 0, -4, -22,
  0, 4, 0, -61, -43, -88, 0, 23, 0, -86, 2, 10, -5, -1, 1, 4,
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  1, -9, -5, 11, 11, 0, 6, -5, 3, 3, -1, -1, -9, -3, 2, 3
};

const int32_t b2_q[] PROGMEM = {
  -206, -62, -32, 12, -61, -15, 59, -12, -91, 1, 109, 130, -92, -92, -2, 70
};

const int8_t W3_q[] PROGMEM = {
  14, -11, -5, 68, -127, -8, -18, -6, 12, -10, 0, -2, 0, -1, -3, -34,
  -40, -27, -16, 9, 21, -70, -47, -24, 18, -43, -33, -30, 6, 1, 34, -81,
  -90, 9, -31, -43, -17, -18, 4, 2, 18, -11, -7, 48, -61, -48, -35, -29,
  6, 1, 6, -27, -22, -11, 12, -11, -116, -107, 6, 8, -21, -17, -7, 26,
  -21, 10, -38, -45, 11, -16, -2, -2, 7, -7, -4, -59, -84, -105, -11, 13
};

const int32_t b3_q[] PROGMEM = {
  21, -24, -48, -38, 33
};

// 10 amostras de teste
const int8_t X_test_q[] PROGMEM = {
  0, 0, 0, 0, 0, 0, 0, 0, 0, 0, 0, 0, 0, 0, 0, 0,
  0, 0, 0, 0, 0, 0, 0, 0, 0, 0, 0, 0, -1, -1, -1, -1,
  -1, -1, -1, -1, -1, -1, -1, -1, -1, -1, -1, -1, -1, -1, -1, -1,
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  0, 0, 0, 0, 0, 0, 0, 0, 0, 0, 0, 0, 0, 0, 0, 0
};

const uint8_t y_labels[] PROGMEM = {
  4, 0, 3, 0, 0, 3, 0, 4, 4, 3
};

static int8_t requant(int32_t acc, int32_t mult, int shift) {
  int64_t x = (int64_t)acc * mult;
  x >>= 31;
  x >>= shift;
  if (x >  127) x =  127;
  if (x < -128) x = -128;
  return (int8_t)x;
}

int mlp_predict(const int8_t *x_in) {

  // Layer 1: z = W1^T * x_in + b1, z1 = ReLU(requant(z))
  int32_t z1[HIDDEN1];
  for (int j = 0; j < HIDDEN1; j++) {
    int32_t acc = ((int32_t)         pgm_read_dword(&b1_q[j]));
    for (int i = 0; i < INPUT_SIZE; i++)
      acc += (int32_t)x_in[i] * ((int32_t)(int8_t) pgm_read_byte (&W1_q[i * HIDDEN1 + j]));
    int8_t v = requant(acc, MULT1, SHIFT1);
    z1[j] = (v > 0) ? (int32_t)v : 0;  // ReLU
  }

  // Layer 2: z = W2^T * z1 + b2, z2 = ReLU(requant(z))
  int32_t z2[HIDDEN2];
  for (int j = 0; j < HIDDEN2; j++) {
    int32_t acc = ((int32_t)         pgm_read_dword(&b2_q[j]));
    for (int i = 0; i < HIDDEN1; i++)
      acc += (int32_t)z1[i] * ((int32_t)(int8_t) pgm_read_byte (&W2_q[i * HIDDEN2 + j]));
    int8_t v = requant(acc, MULT2, SHIFT2);
    z2[j] = (v > 0) ? (int32_t)v : 0;  // ReLU
  }

  // Layer 3: z = W3^T * z2 + b3  (raw accumulator – argmax invariant to scale)
  int32_t logits[OUTPUT_SIZE];
  for (int j = 0; j < OUTPUT_SIZE; j++) {
    int32_t acc = ((int32_t)         pgm_read_dword(&b3_q[j]));
    for (int i = 0; i < HIDDEN2; i++)
      acc += (int32_t)z2[i] * ((int32_t)(int8_t) pgm_read_byte (&W3_q[i * OUTPUT_SIZE + j]));
    logits[j] = acc;  // mantém acumulador para argmax
  }

  // Argmax
  int best = 0;
  for (int k = 1; k < OUTPUT_SIZE; k++)
    if (logits[k] > logits[best]) best = k;
  return best;
}

const float VCC      = 5.0;
const float I_ACTIVE = 0.020;
const float POWER_W  = VCC * I_ACTIVE;

void setup() {
  Serial.begin(115200);
  Serial.println("Validacao MLP INT8");

  int correct = 0;
  float total_joules  = 0;
  unsigned long total_time_us = 0;

  for (int n = 0; n < N_TEST; n++) {
    int8_t sample[INPUT_SIZE];
    for (int i = 0; i < INPUT_SIZE; i++)
      sample[i] = ((int8_t)          pgm_read_byte (&X_test_q[n * INPUT_SIZE + i]));

    unsigned long t_start = micros();
    int pred = mlp_predict(sample);
    unsigned long t_end   = micros();

    unsigned long duration_us = t_end - t_start;
    total_time_us += duration_us;
    float duration_sec  = duration_us / 1000000.0;
    float energy_joules = POWER_W * duration_sec;
    total_joules += energy_joules;

    int label = (int)pgm_read_byte(&y_labels[n]);
    if (pred == label) correct++;

    Serial.print("Amostra "); Serial.print(n);
    Serial.print(" | Pred: ");    Serial.print(pred);
    Serial.print(" | Real: ");    Serial.print(label);
    Serial.print(" | Tempo: ");   Serial.print(duration_us);   Serial.print("us");
    Serial.print(" | Energia: "); Serial.print(energy_joules, 10); Serial.println(" J");
  }

  float avg_time_us = (float)total_time_us / N_TEST;
  float avg_joules  = total_joules / N_TEST;

  Serial.println("------------------------------------------");
  Serial.print("Acuracia Final: "); Serial.print(correct); Serial.print("/"); Serial.println(N_TEST);
  Serial.print("Tempo Medio por Amostra: "); Serial.print(avg_time_us); Serial.println(" us");
  Serial.print("Energia Media por Amostra: "); Serial.print(avg_joules, 10); Serial.println(" J");
  Serial.print("Tempo Total: "); Serial.print(total_time_us / 1000.0); Serial.println(" ms");
  Serial.print("Energia Total: "); Serial.print(total_joules, 8); Serial.println(" J");
  Serial.println("------------------------------------------");
}

void loop() {}
